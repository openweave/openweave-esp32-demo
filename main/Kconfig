## main/Kconfig
```kconfig
menu "Blue Sky Demo App"

    choice
        prompt "Device Type"
        default DEVICE_TYPE_ESP32_DEVKITC
        help
            Specifies the type of ESP32 device.
            
            Note that the "ESP32-DevKitC" choice is compatible with a number of clone devices
            available from third-party manufacturers.
            
        config DEVICE_TYPE_ESP32_DEVKITC
            bool "ESP32-DevKitC"
        config DEVICE_TYPE_M5STACK
            bool "M5Stack"
    endchoice
    
    # NOTE: This config is not displayed as a input in the Kconfig menu, as its value is
    # entirely derived from the Device Type choice.  However the CONFIG_EXAMPLE_DISPLAY_TYPE
    # define that is produced is needed to configure the TFT library correctly.

    config EXAMPLE_DISPLAY_TYPE
        int
        range 0 3
        default 0 if DEVICE_TYPE_ESP32_DEVKITC
        default 3 if DEVICE_TYPE_M5STACK

    config FACTORY_RESET_BUTTON_DURATION
        int "Factory Reset Button Duration (ms)"
        range 0 65535
        default 5000
        help
            The amount of time (in milliseconds) that the user must press the attention
            button to initiate a factory reset.

    config ALIVE_INTERVAL
        int "Alive Interval (ms)"
        range 0 65535
        default 5000
        help
            Configures the demo application to periodically print an "Alive" message
            confirming that the Weave thread is alive and processing events.  A value
            of 0 disables the feature.

    config SERVICE_ECHO_INTERVAL
        int "Service Echo Interval (ms)"
        range 0 65535
        default 0
        help
            Configures the demo application to periodically send Weave EchoRequest messages
            to the Nest service whenever the service tunnel is up.  A value of 0 disables
            the feature.

endmenu
```

## main/Kconfig.projbuild
```kconfig
#
#    Copyright (c) 2018 Nest Labs, Inc.
#    All rights reserved.
#
#    Licensed under the Apache License, Version 2.0 (the "License");
#    you may not use this file except in compliance with the License.
#    You may obtain a copy of the License at
#
#        http://www.apache.org/licenses/LICENSE-2.0
#
#    Unless required by applicable law or agreed to in writing, software
#    distributed under the License is distributed on an "AS IS" BASIS,
#    WITHOUT WARRANTIES OR CONDITIONS OF ANY KIND, either express or implied.
#    See the License for the specific language governing permissions and
#    limitations under the License.
#
#    Description:
#      Configuration options OpenWeave ESP32 demo application.
#

menu "OpenWeave ESP32 Demo"

    choice
        prompt "Device Type"
        default DEVICE_TYPE_ESP32_DEVKITC
        help
            Specifies the type of ESP32 device.
            
            Note that the "ESP32-DevKitC" choice is compatible with a number of clone devices
            available from third-party manufacturers.
            
        config DEVICE_TYPE_ESP32_DEVKITC
            bool "ESP32-DevKitC"
        config DEVICE_TYPE_M5STACK
            bool "M5Stack"
    endchoice
    
    # NOTE: This config is not displayed as a input in the Kconfig menu, as its value is
    # entirely derived from the Device Type choice.  However the CONFIG_EXAMPLE_DISPLAY_TYPE
    # define that is produced is needed to configure the TFT library correctly.

    config EXAMPLE_DISPLAY_TYPE
        int
        range 0 3
        default 0 if DEVICE_TYPE_ESP32_DEVKITC
        default 3 if DEVICE_TYPE_M5STACK

    config FACTORY_RESET_BUTTON_DURATION
        int "Factory Reset Button Duration (ms)"
        range 0 65535
        default 5000
        help
            The amount of time (in milliseconds) that the user must press the attention
            button to initiate a factory reset.

    config ALIVE_INTERVAL
        int "Alive Interval (ms)"
        range 0 65535
        default 5000
        help
            Configures the demo application to periodically print an "Alive" message
            confirming that the Weave thread is alive and processing events.  A value
            of 0 disables the feature.

    config SERVICE_ECHO_INTERVAL
        int "Service Echo Interval (ms)"
        range 0 65535
        default 0
        help
            Configures the demo application to periodically send Weave EchoRequest messages
            to the Nest service whenever the service tunnel is up.  A value of 0 disables
            the feature.

endmenu
```

## sdkconfig.defaults
```kconfig
#
# Some useful defaults for the demo app configuration.
#

# Enable BLE
CONFIG_BT_ENABLED=y
CONFIG_GATTS_ENABLE=y
CONFIG_GATTC_ENABLE=
CONFIG_BLE_SMP_ENABLE=
CONFIG_BT_ACL_CONNECTIONS=2

# Use a custom partition table
CONFIG_PARTITION_TABLE_CUSTOM=y
CONFIG_PARTITION_TABLE_CUSTOM_FILENAME="partitions.csv"
CONFIG_PARTITION_TABLE_CUSTOM_APP_BIN_OFFSET=0x10000
CONFIG_PARTITION_TABLE_FILENAME="partitions.csv"
CONFIG_APP_OFFSET=0x10000

# Bump the stack size of the Weave task to accommodate extra stack useage due to
# debugging.
CONFIG_WEAVE_TASK_STACK_SIZE=5120

# Default to 921600 baud when flashing and monitoring device
CONFIG_ESPTOOLPY_BAUD_921600B=y
CONFIG_ESPTOOLPY_BAUD=921600
CONFIG_ESPTOOLPY_COMPRESSED=y
CONFIG_MONITOR_BAUD_115200B=y
CONFIG_MONITOR_BAUD=115200

# Enable various features that make it easier to debug secure Weave communication.
# WARNING: This option SHOULD NEVER BE ENABLED IN PRODUCTION BUILDS.
CONFIG_SECURITY_TEST_MODE=y

# Disable authentication checks for various device provisioning operations.
# WARNING: This option SHOULD NEVER BE ENABLED IN PRODUCTION BUILDS.
CONFIG_DISABLE_PROVISIONING_AUTH=y

# Print debug information related to certificate validation.
CONFIG_DEBUG_CERT_VALIDATION=y

# Log the device's provisioning hash at boot.
CONFIG_LOG_PROVISIONING_HASH=y

# Disable automatic closing of idle incoming connections.  This makes it possible
# to maintain an idle Weave Device Manager connection with the device for testing
# purposes.
CONFIG_DEFAULT_INCOMING_CONNECTION_IDLE_TIMEOUT=0
```
